## ldd-k4/arm/trustzone/safeg-1.2.2/com/src/target/imx6_nt_linux/Kconfig
```kconfig
config SAFEG
	bool "Enable SafeG extensions"
	default y
	help
	  Enables SafeG extensions to the Linux kernel.

config SAFEG_DOSCOM
	bool "Inter-OS communications"
	depends on SAFEG
	default y
	help
	  Enable SafeG inter-OS communications framework.
```
